/*
 * Copyright (c) 2020 Pete Johanson
 *
 * SPDX-License-Identifier: MIT
 */

        right_encoder: encoder_right {
                compatible = "alps,ec11";
                label = "RIGHT_ENCODER";
                a-gpios = <&pro_micro_d 9 (GPIO_ACTIVE_HIGH | GPIO_PULL_UP)>;
                b-gpios = <&pro_micro_d 10 (GPIO_ACTIVE_HIGH | GPIO_PULL_UP)>;
                resolution = <3>;
        };

        sensors {
                compatible = "zmk,keymap-sensors";
                sensors = <&right_encoder>;
        };

};
