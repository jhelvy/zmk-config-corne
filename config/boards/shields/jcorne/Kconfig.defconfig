## config/boards/shields/jcorne/Kconfig.defconfig
```kconfig
if SHIELD_JCORNE_LEFT

config ZMK_KEYBOARD_NAME
    default "jCorne Left"

endif

if SHIELD_JCORNE_RIGHT

config ZMK_KEYBOARD_NAME
    default "jCorne Right"

config ZMK_SPLIT_BLE_ROLE_CENTRAL
    default y

endif

if SHIELD_JCORNE_LEFT || SHIELD_JCORNE_RIGHT

config ZMK_SPLIT
    default y

endif
```

## config/boards/shields/jcorne/Kconfig.shield
```kconfig
# Copyright (c) 2020 Pete Johanson
# SPDX-License-Identifier: MIT

config SHIELD_JCORNE_LEFT
	def_bool $(shields_list_contains,jcorne_left)

config SHIELD_JCORNE_RIGHT
	def_bool $(shields_list_contains,jcorne_right)
```

## config/west.yml
```yaml
manifest:
  remotes:
    - name: zmkfirmware
      url-base: https://github.com/zmkfirmware
    - name: stephen
      url-base: https://github.com/stephen
  projects:
    - name: zmk
      remote: stephen
      revision: main
      import: app/west.yml
  self:
    path: config
```
