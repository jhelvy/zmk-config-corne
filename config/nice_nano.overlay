/*
 * Copyright (c) 2020 The ZMK Contributors
 *
 * SPDX-License-Identifier: MIT
 */
&spi1 {
	compatible = "nordic,nrf-spi";
	/* Cannot be used together with i2c0. */
	status = "okay";
	mosi-pin = <9>;
	// Unused pins, needed for SPI definition, but not used by the ws2812 driver itself.
	sck-pin = <43>;
	miso-pin = <10>;
};
